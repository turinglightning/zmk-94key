/*
 * Copyright (c) 2022 Duccio Breschi
 *
 * SPDX-License-Identifier: MIT
 */

#include "swoop.dtsi"

&kscan0 {
    diode-direction = "col2row";
    col-gpios
        = <&gpio1 6  GPIO_ACTIVE_HIGH>
		, <&gpio1 4  GPIO_ACTIVE_HIGH>
		, <&gpio0 11  GPIO_ACTIVE_HIGH>
		, <&gpio1 00 GPIO_ACTIVE_HIGH>
		, <&gpio0 24  GPIO_ACTIVE_HIGH>
		, <&gpio0 22 GPIO_ACTIVE_HIGH>
		, <&gpio0 20 GPIO_ACTIVE_HIGH>
		;
};

&left_encoder {
	status = "okay";
};
